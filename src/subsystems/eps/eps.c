/**
 * @file eps.c
 * @brief Implementation of the EPS task.
 * 
 */

#include "eps.h"
#include <stdint.h>
#include <stdbool.h>
#include <stdio.h>
#include <string.h>
#include "health.h"
#include "flash.h"
#include "notifications.h"
#include "events.h"
#include "main.h"
#include "task_management.h"

// The main functionality of the EPS task is providing the OBC with battery readings on
// it's voltage, current generated, capacity, temperature and charging status. The task
// will also indicate any error generated by the Power Management IC.

// Battery state machine hysteresis (rising-direction only, in mV)
#define EPS_HYSTERESIS_MV    50u

// Fixed supervisory heartbeat. The task wakes at least this often to read the
// sensors, update the state machine and kick the watchdog, independently of the
// (reconfigurable) telemetry sampling period. Must stay below the OBC software
// watchdog window (5 s, see health_config() in obc.c) with margin.
#define EPS_TICK_MS          1000u

/** @brief Notification bits deferred while the EPS task is paused. */
static uint32_t deferred_notifications;

static TaskHandle_t eps_task_handle  = NULL;
static bool         auto_heat_enabled  = false;

// Unit convention: ALL voltages in mV, temperatures in °C, currents in mA.
// Stored in flash as 1 byte each in units of 100 mV (matches the 3-byte TC format).
static uint16_t thresholds_mv[3] = {3700, 3300, 3000}; // [0] nominal, [1] contingency, [2] sunsafe
static int8_t   heater_hysteresis_c[2] = {0, 5};       // ON below [0], OFF above [1]
static uint16_t sampling_period_100ms  = 10;           // 10 x 100 ms = 1 s default

// Tick of the last telemetry write; drives the periodic-telemetry timer. Telemetry
// is written every sampling_period OR immediately on a significant change.
static TickType_t last_telemetry_tick = 0;

volatile uint32_t eps_cycle_count = 0;

//eventGroup
EventGroupHandle_t batteryStatus = NULL;

// Function prototypes
static void setup_eps(void);
static void process_eps(void);
static HAL_StatusTypeDef send_telemetry_to_obdh(EPS_Telemetry_Frame_t *frame);
static void load_thresholds_from_flash(void);
static void load_sampling_from_flash(void);
static void load_heater_bands_from_flash(void);

void eps_task(void *pv_parameters)
{
    eps_task_handle = xTaskGetCurrentTaskHandle();
    (void)pv_parameters;
    setup_eps();

    for (;;) {
        process_eps();
        health_kick(HEALTH_BIT_EPS);
    }

}

/**
 * @brief Initialize EPS task state.
 */
static void setup_eps(void)
{
    deferred_notifications = 0;
    last_telemetry_tick = xTaskGetTickCount();

    batteryStatus = xEventGroupCreate();

    if (batteryStatus != NULL) {
        // Set the default startup state to NOMINAL on boot
        xEventGroupSetBits(batteryStatus, EV_BAT_NOMINAL);
    }

    /* EPS pins (PMIC inputs, CHRGOFF, heater, CLPROG) are configured centrally
     * in periph_gpio_init() before the scheduler starts (pin map in periph.h). */

    // Apply the default configuration

    // Recovery
    uint8_t saved_heater_conf = 0;
    if (OBDH_Read_Request(HEATER_CONFIG_ADDR, &saved_heater_conf, 1) == HAL_OK)
        auto_heat_enabled = (saved_heater_conf == 1);
    else
        auto_heat_enabled = false;

    // Heater OFF, eps will set it again if necessary
    eps_hw_heater_set(false);

    // Restore charger state from flash; default to enabled on fresh flash (0xFF)
    uint8_t saved_charger_conf = 1;
    if (OBDH_Read_Request(CHARGER_CONFIG_ADDR, &saved_charger_conf, 1) == HAL_OK && saved_charger_conf != 0xFF) {
        eps_hw_charger_set(saved_charger_conf == 1);
    } else
        eps_hw_charger_set(true);

    // recover thresholds:
    load_thresholds_from_flash();
    load_sampling_from_flash();
    load_heater_bands_from_flash();

    /* Boot-time self-check: probe the fuel gauge and log one voltage reading
     * (see eps_hw_probe()). Pins and buses are already up via periph init. */
    eps_hw_probe();
}


/**
 * @brief Execute one EPS task processing cycle. 
 *
 * Handles the task pause/resume protocol and processes pending EPS 
 * task notifications.
 */
static void process_eps(void)
{
    // Wait bounded by the fixed heartbeat so the watchdog is kicked regularly even
    // when the telemetry sampling period is long. A sampling period shorter than
    // the heartbeat is honoured directly.
    uint32_t period_ms = (uint32_t)sampling_period_100ms * 100u;
    uint32_t wait_ms   = (period_ms < EPS_TICK_MS) ? period_ms : EPS_TICK_MS;
    uint32_t notifications = wait_for_notification(pdMS_TO_TICKS(wait_ms));

    if (tm_check_pause(notifications, &deferred_notifications))
        return;

    notifications |= deferred_notifications;
    deferred_notifications = 0;

    // A "significant change" forces an immediate telemetry write so the recorded
    // frame always reflects the event that caused it. Control telecommands that
    // alter an observable status flag also count as significant.
    bool important = (notifications & (N_EPS_FAULT_DETECTED |
                                       N_EPS_ECLIPSE_START | N_EPS_ECLIPSE_END |
                                       N_EPS_ENABLE_CHARGER | N_EPS_DISABLE_CHARGER |
                                       N_EPS_ENABLE_AUTO_HEAT | N_EPS_DISABLE_AUTO_HEAT)) != 0;

    if (notifications & N_EPS_NEW_THRESHOLDS) {
        load_thresholds_from_flash();
        // Thresholds are now in the thresholds array, in the order: 
        // thresholds[0]: nominal
        // thresholds[1]: contingency
        // thresholds[2]: sunsafe 
    }

    if (notifications & N_EPS_NEW_SAMPLING)
        load_sampling_from_flash();

    if (notifications & N_EPS_NEW_HEATER_BANDS)
        load_heater_bands_from_flash();

    if (notifications & N_EPS_ENABLE_AUTO_HEAT) {
        // enable EPS heater and save to flash
        auto_heat_enabled = true;
        uint8_t new_conf = 1;
        OBDH_Write_Request(HEATER_CONFIG_ADDR, &new_conf, 1);
    }

    if (notifications & N_EPS_DISABLE_AUTO_HEAT) {
        auto_heat_enabled = false;
        uint8_t new_conf = 0;
        OBDH_Write_Request(HEATER_CONFIG_ADDR, &new_conf, 1);
        eps_hw_heater_set(false);
    }

    if (notifications & N_EPS_ENABLE_CHARGER) {
        eps_hw_charger_set(true);
        uint8_t conf = 1;
        OBDH_Write_Request(CHARGER_CONFIG_ADDR, &conf, 1);
    }

    if (notifications & N_EPS_DISABLE_CHARGER) {
        eps_hw_charger_set(false);
        uint8_t conf = 0;
        OBDH_Write_Request(CHARGER_CONFIG_ADDR, &conf, 1);
    }

    if (notifications & N_EPS_FAULT_DETECTED) {
        // Charger already disabled by ISR. Persist the disabled state so it
        // survives a reboot. OBC re-enables via N_EPS_ENABLE_CHARGER.
        uint8_t conf = 0;
        OBDH_Write_Request(CHARGER_CONFIG_ADDR, &conf, 1);
    }

    // N_EPS_ECLIPSE_START / N_EPS_ECLIPSE_END (!PFO power-fail assert/clear): no
    // software action needed. The PMIC handles the power path automatically;
    // the !PFO state (input power lost — commonly eclipse, but not only) is reflected
    // in telemetry via eps_hw_read_pmic() polling the !PFO pin each cycle.

    // 2. Poll battery sensor (DS2782E+) for voltage, current and capacity. This IC is
    // connected to the IC2 line 1 (SCL1,SDA1).
    // 3. Send to OBDH task for it to store to flash

    static Battery_Telemetry_t battery_sensor;
    static EPS_Status_t eps_status;
    static EPS_Telemetry_Frame_t frame;
    bool battery_ok = eps_hw_read_battery(&battery_sensor);
    bool pmic_ok = eps_hw_read_pmic(&eps_status);

    if (battery_ok) {

        uint16_t vbat_mv = eps_hw_battery_voltage_mv(&battery_sensor);
        int16_t temp_c = eps_hw_battery_temp_c(&battery_sensor);

        // manage batteryStatus EventGroup; a state transition is significant
        important |= EPS_Update_System_State(vbat_mv);

        // auto heater
        EPS_Heater_Control(temp_c);

    } else {
        // fail logic

    }

    if (pmic_ok) {
        if (eps_status.has_fault && !eps_status.charging_disabled) {
            eps_hw_charger_set(false);
            uint8_t conf = 0;
            OBDH_Write_Request(CHARGER_CONFIG_ADDR, &conf, 1);
            important = true;
        }
    } else {
        //fail logic

    }

    // read heater status
    eps_status.auto_heater_enabled = auto_heat_enabled;
    eps_status.heater_state = eps_hw_heater_get();

    // read status
    eps_status.battery_read_failure = !battery_ok;
    eps_status.pmic_read_failure = !pmic_ok;

    // Telemetry is written on the configurable period OR immediately on a
    // significant change, so the recorded frame stays consistent with the state.
    // When the period is at or below the heartbeat, write every tick (preserves
    // the original behaviour at the default settings).
    uint32_t cur_period_ms = (uint32_t)sampling_period_100ms * 100u;
    TickType_t now = xTaskGetTickCount();
    bool telemetry_due = (cur_period_ms <= EPS_TICK_MS) ||
                         ((now - last_telemetry_tick) >= pdMS_TO_TICKS(cur_period_ms));

    if (important || telemetry_due) {
        eps_frame_pack(&battery_sensor, &eps_status, &frame);
        HAL_StatusTypeDef telem_status = send_telemetry_to_obdh(&frame);
        last_telemetry_tick = now;
        printf("[EPS] tick %lu | batt_ok=%d pmic_ok=%d obdh=%d %s\r\n",
               eps_cycle_count, (int)battery_ok, (int)pmic_ok, (int)telem_status,
               important ? "(event)" : "(periodic)");
    }

    eps_cycle_count++;
}

static HAL_StatusTypeDef send_telemetry_to_obdh(EPS_Telemetry_Frame_t *frame)
{
    return OBDH_Write_Request(
        OBDH_EPS_TELEMETRY_ADDR,
        (uint8_t*)frame,
        sizeof(EPS_Telemetry_Frame_t)
    );
}

// Hardware access lives in eps_hw_pocat.c / ds2782.c / ltc4040.c; the
// telemetry frame layout and packing live in eps_frame.c.

/**
 * @brief Update batteryStatus event group based on measured voltage.
 *
 * Implements an asymmetric hysteresis state machine:
 *   - Falling transitions (toward more severe state) are immediate and may
 *     skip intermediate states in a single call. Battery protection takes
 *     precedence over response smoothness.
 *   - Rising transitions (toward less severe state) advance one state per
 *     call and require voltage to exceed the threshold by EPS_HYSTERESIS_MV.
 *     This suppresses load-sag flap and ensures recovery is real.
 *
 * @param vbat_mv Measured battery voltage in millivolts.
 */
bool EPS_Update_System_State(uint16_t vbat_mv)
{
    if (batteryStatus == NULL)
        return false;

    uint32_t current_state = xEventGroupGetBits(batteryStatus) & ALL_BATTERY_STATES;
    uint32_t new_state     = current_state;

    switch (current_state) {
        case EV_BAT_NOMINAL:
            if      (vbat_mv < thresholds_mv[2]) new_state = EV_BAT_SURVIVAL;
            else if (vbat_mv < thresholds_mv[1]) new_state = EV_BAT_SUNSAFE;
            else if (vbat_mv < thresholds_mv[0]) new_state = EV_BAT_CONTINGENCY;
            break;

        case EV_BAT_CONTINGENCY:
            if      (vbat_mv < thresholds_mv[2]) new_state = EV_BAT_SURVIVAL;
            else if (vbat_mv < thresholds_mv[1]) new_state = EV_BAT_SUNSAFE;
            else if (vbat_mv >= thresholds_mv[0] + EPS_HYSTERESIS_MV)
                                                 new_state = EV_BAT_NOMINAL;
            break;

        case EV_BAT_SUNSAFE:
            if      (vbat_mv < thresholds_mv[2]) new_state = EV_BAT_SURVIVAL;
            else if (vbat_mv >= thresholds_mv[1] + EPS_HYSTERESIS_MV)
                                                 new_state = EV_BAT_CONTINGENCY;
            break;

        case EV_BAT_SURVIVAL:
            if (vbat_mv >= thresholds_mv[2] + EPS_HYSTERESIS_MV)
                                                 new_state = EV_BAT_SUNSAFE;
            break;

        default:
            break;
    }

    if (new_state != current_state) {
        xEventGroupClearBits(batteryStatus, ALL_BATTERY_STATES);
        xEventGroupSetBits(batteryStatus, new_state);
        return true;
    }
    return false;
}

/** Auto-heater hysteresis. Only acts when auto-heat is enabled by telecommand. */
void EPS_Heater_Control(int16_t temp_c)
{
    if (!auto_heat_enabled)
        return;
    if (temp_c < heater_hysteresis_c[0])
        eps_hw_heater_set(true);
    else if (temp_c > heater_hysteresis_c[1])
        eps_hw_heater_set(false);
}

/** Load thresholds from flash; keep current values if the data is implausible. */
static void load_thresholds_from_flash(void)
{
    uint8_t raw[3];
    if (OBDH_Read_Request(EPS_THRESHOLDS_ADDR, raw, 3) != HAL_OK)
        return;
    for (int i = 0; i < 3; i++)
        if (raw[i] < 25 || raw[i] > 45)      // plausible battery range 2.5–4.5 V
            return;
    if (!(raw[0] > raw[1] && raw[1] > raw[2])) // must be strictly descending
        return;
    for (int i = 0; i < 3; i++)
        thresholds_mv[i] = (uint16_t)raw[i] * 100u;
}

/** Load sampling period from flash; reject erased/zero values, clamp the minimum. */
static void load_sampling_from_flash(void)
{
    uint16_t raw;
    if (OBDH_Read_Request(EPS_SAMPLING_ADDR, (uint8_t *)&raw, 2) != HAL_OK)
        return;
    if (raw == 0x0000u || raw == 0xFFFFu)    // unprogrammed / erased flash
        return;
    if (raw < 5u)                            // DS2782 updates every ~440 ms; floor 500 ms
        raw = 5u;
    sampling_period_100ms = raw;
}

/** Load heater hysteresis bands from flash. Requires upper > lower with a
 *  minimum 2 °C deadband to prevent relay chatter near the threshold. */
static void load_heater_bands_from_flash(void)
{
    int8_t raw[2];
    if (OBDH_Read_Request(HEATER_BANDS_ADDR, (uint8_t *)raw, 2) != HAL_OK)
        return;
    if ((uint8_t)raw[0] == 0xFFu && (uint8_t)raw[1] == 0xFFu)   // erased flash
        return;
    if ((int)raw[1] - (int)raw[0] < 2)        // require minimum 2 °C deadband
        return;
    heater_hysteresis_c[0] = raw[0];
    heater_hysteresis_c[1] = raw[1];
}

/**
 * @brief Called from EXTI4_IRQHandler in stm32l4xx_it.c (PC4 !FAULT, falling edge).
 *
 * Disables the charger immediately — GPIO write is ISR-safe.
 * Wakes eps_task via notification so it can persist the disabled state to flash.
 * Wakes up obc_task via notification so it can handle the fault
 */
void EPS_Fault_IRQHandler(void)
{
    eps_hw_charger_set(false);

    BaseType_t woken = pdFALSE;

    if (eps_task_handle != NULL) {
        xTaskNotifyFromISR(eps_task_handle, N_EPS_FAULT_DETECTED, eSetBits, &woken);
    }

    TaskHandle_t obc = main_get_obc_handle();
    if (obc != NULL) {
        xTaskNotifyFromISR(obc, N_OBC_EPS_FAULT_DETECTED, eSetBits, &woken);
    }

    portYIELD_FROM_ISR(woken);
}

/**
 * @brief Called from EXTI9_5_IRQHandler in stm32l4xx_it.c (PB5 !PFO, both edges).
 *
 * Reads the current pin state to distinguish power-fail assert (!PFO falling, input
 * power lost — commonly eclipse, but not only) from clear (!PFO rising, power restored)
 * and wakes eps_task. No hardware action — LTC4040 handles the power path automatically.
 * Wakes up obc_task so it can handle the power-fail state.
 */
void EPS_PFO_IRQHandler(void)
{
    bool is_eclipse_start = eps_hw_pfo_is_asserted();

    uint32_t eps_notif = is_eclipse_start ? N_EPS_ECLIPSE_START : N_EPS_ECLIPSE_END;
    uint32_t obc_notif = is_eclipse_start ? N_OBC_EPS_ECLIPSE_START : N_OBC_EPS_ECLIPSE_END;

    BaseType_t woken = pdFALSE;

    if (eps_task_handle != NULL) {
        xTaskNotifyFromISR(eps_task_handle, eps_notif, eSetBits, &woken);
    }

    TaskHandle_t obc = main_get_obc_handle();
    if (obc != NULL) {
        xTaskNotifyFromISR(obc, obc_notif, eSetBits, &woken);
    }

    portYIELD_FROM_ISR(woken);
}

#ifdef UNIT_TEST
void EPS_Test_Set_Thresholds_mV(const uint16_t mv[3])
{
    for (int i = 0; i < 3; i++) thresholds_mv[i] = mv[i];
}
void EPS_Test_Set_Auto_Heat(bool enable) { auto_heat_enabled = enable; }
#endif
